// SPDX-License-Identifier: (GPL-2.0+ OR MIT)
/*
 * Copyright 2021 NXP
 */

#include "imx8mp-evk-root.dts"

&i2c3 {
	status = "disabled";
};

&sai3 {
	status = "disabled";
};

&sai5 {
	status = "disabled";
};
